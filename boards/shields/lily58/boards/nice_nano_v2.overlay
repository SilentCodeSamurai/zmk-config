#include <dt-bindings/led/led.h>

/ {
    chosen {
        zmk,underglow = &led_strip;
    };
};

&gpio0 {
    status = "okay";
};

/ {
    led_strip: ws2812 {
        compatible = "worldsemi,ws2812-gpio";
        in-gpios = <&gpio0 6 0>;
        chain-length = <35>;
        color-mapping = <LED_COLOR_ID_GREEN LED_COLOR_ID_RED LED_COLOR_ID_BLUE>;
    };
};
